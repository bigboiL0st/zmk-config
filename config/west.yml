## config/west.yml
```yaml
manifest:
  remotes:
    - name: zmkfirmware
      url-base: https://github.com/zmkfirmware
    - name: nguyendown
      url-base: https://github.com/nguyendown
  projects:
    - name: zmk
      remote: bigboiL0st
      revision: L0st
      import: app/west.yml
  self:
    path: config
```

## zmk-config-cresk-100/config/west.yml
```yaml
manifest:
  remotes:
    - name: zmkfirmware
      url-base: https://github.com/zmkfirmware
    - name: bigboiL0st
      url-base: https://github.com/bigboiL0st
  projects:
    - name: zmk
      remote: bigboiL0st
      revision: cresk
      import: app/west.yml
  self:
    path: config
```
